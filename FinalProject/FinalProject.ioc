# file: FinalProject.ioc
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Mcu.Family=STM32F0
Mcu.Name=STM32F072R(8-B)Tx
Mcu.Package=LQFP64
ProjectManager.HeapSize=0x200
ProjectManager.StackSize=0x400
ProjectManager.TargetToolchain=MDK-ARM V5.32
board=custom

// file: Core/Src/main.c
/* USER CODE BEGIN Header */
/**
  ******************************************************************************
  * @file           : main.c
  * @brief          : Main program body
  ******************************************************************************
  * @attention
  *
  * Copyright (c) 2022 STMicroelectronics.
  * All rights reserved.
  *
  * This software is licensed under terms that can be found in the LICENSE file
  * in the root directory of this software component.
  * If no LICENSE file comes with this software, it is provided AS-IS.
  *
  ******************************************************************************
  */
/* USER CODE END Header */
#include "main.h"
#include "I2C.h"
#include "motor.h"

/* USER CODE BEGIN PV */
MPU6050_t MPU6050;

/* USER CODE END PV */

void SystemClock_Config(void);

int main(void)
{

  /* MCU Configuration--------------------------------------------------------*/

  /* Reset of all peripherals, Initializes the Flash interface and the Systick. */
  HAL_Init();
	__HAL_RCC_GPIOC_CLK_ENABLE(); // Enable the GPIOC clock in the RCC
  __HAL_RCC_GPIOB_CLK_ENABLE(); // Enable the GPIOB clock in the RCC
	__HAL_RCC_I2C2_CLK_ENABLE(); //enable i2c2 clk

  /* USER CODE BEGIN Init */
	I2C2_init();
	//who_am_i(); //comment out, used to test if device is correctly reachables
	wake_up_mpu();
	sample_rate();
	gyro_Init();
	accel_Init();

	motor_init();

  /* USER CODE END Init */

  /* Configure the system clock */
  SystemClock_Config();

	volatile uint32_t encoder_count = 0;

	while(1){
		read_gyro(&MPU6050);

		//delay just in case
		HAL_Delay(128);

		read_accel(&MPU6050);

		//delay just in case
		HAL_Delay(128);

		encoder_count = TIM2->CNT;

		//delay just in case
		HAL_Delay(128);

		if(MPU6050.Gy > 0 && MPU6050.Ay > 0){  //if robot is leaning forward and accelerating, rotate motors backward to correct
			target_rpm = -50;
			PI_update();
		}
		else if (MPU6050.Gy < 0 && MPU6050.Ay > 0){ //if robot is leaning backwards and accelerrating, rotate motors forward to correct
			target_rpm = 50;
			PI_update();
		}
		else if (MPU6050.Gy > 0 && MPU6050.Ay < 0){ //if robot is leaning backwards and slowing down, rotate motors backward slowly
			target_rpm = -25;
			PI_update();
		}
		else if (MPU6050.Gy < 0 && MPU6050.Ay < 0){ //if robot is leaning backwards and slowing down, rotate motors forward slowly
			target_rpm = 25;
			PI_update();
		}
		else {
			target_rpm = 40; //just move at 40rpm
			PI_update();
		}

	}

}

void SystemClock_Config(void)
{
  RCC_OscInitTypeDef RCC_OscInitStruct = {0};
  RCC_ClkInitTypeDef RCC_ClkInitStruct = {0};

  /** Initializes the RCC Oscillators according to the specified parameters
  * in the RCC_OscInitTypeDef structure.
  */
  RCC_OscInitStruct.OscillatorType = RCC_OSCILLATORTYPE_HSI;
  RCC_OscInitStruct.HSIState = RCC_HSI_ON;
  RCC_OscInitStruct.HSICalibrationValue = RCC_HSICALIBRATION_DEFAULT;
  RCC_OscInitStruct.PLL.PLLState = RCC_PLL_NONE;
  if (HAL_RCC_OscConfig(&RCC_OscInitStruct) != HAL_OK)
  {
    Error_Handler();
  }
  /** Initializes the CPU, AHB and APB buses clocks
  */
  RCC_ClkInitStruct.ClockType = RCC_CLOCKTYPE_HCLK|RCC_CLOCKTYPE_SYSCLK
                              |RCC_CLOCKTYPE_PCLK1;
  RCC_ClkInitStruct.SYSCLKSource = RCC_SYSCLKSOURCE_HSI;
  RCC_ClkInitStruct.AHBCLKDivider = RCC_SYSCLK_DIV1;
  RCC_ClkInitStruct.APB1CLKDivider = RCC_HCLK_DIV1;

  if (HAL_RCC_ClockConfig(&RCC_ClkInitStruct, FLASH_LATENCY_0) != HAL_OK)
  {
    Error_Handler();
  }
}

void Error_Handler(void)
{
  __disable_irq();
  while (1)
  {
  }
}
